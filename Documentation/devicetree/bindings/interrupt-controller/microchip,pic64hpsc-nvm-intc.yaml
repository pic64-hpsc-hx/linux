## Documentation/devicetree/bindings/interrupt-controller/microchip,pic64hpsc-nvm-intc.yaml
```yaml
# SPDX-License-Identifier: (GPL-2.0-only OR BSD-2-Clause)
%YAML 1.2
---
$id: http://devicetree.org/schemas/interrupt-controller/microchip,pic64hpsc-nvm-intc.yaml#
$schema: http://devicetree.org/meta-schemas/core.yaml#

title: Microchip PIC64-HPSC/HX NVM interrupt controller

maintainers:
  - Charles Perry <charles.perry@microchip.com>

description: |
  The xSPI, NAND and eMMC/SD controllers of the PIC64-HPSC/HX NVM
  subsystem share a single level-high interrupt line to the RISC-V APLIC.
  This controller latches the interrupt of each source, gates it with a
  per-source enable bit, and exposes the current level of each source
  line, so that the shared line can be demultiplexed.

  The interrupt specifier of a child device has one cell, the local
  source number, which is the bit of the source in the controller
  registers:
    - 2: xSPI
    - 3: eMMC/SD
    - 6: NAND

  All the local sources are level high. The other bits of the controller
  registers are error and wakeup signals, which are not valid local
  sources.

properties:
  compatible:
    const: microchip,pic64hpsc-nvm-intc

  reg:
    maxItems: 1

  interrupts:
    maxItems: 1
    description: Shared NVM interrupt line, connected to the APLIC.

  interrupt-controller: true

  "#interrupt-cells":
    const: 1

required:
  - compatible
  - reg
  - interrupts
  - interrupt-controller
  - "#interrupt-cells"

additionalProperties: false

examples:
  - |
    #include <dt-bindings/interrupt-controller/irq.h>

    bus {
        #address-cells = <2>;
        #size-cells = <2>;

        nvm_intc: interrupt-controller@4001c020000 {
            compatible = "microchip,pic64hpsc-nvm-intc";
            reg = <0x400 0x1c020000 0x0 0x518>;
            interrupt-parent = <&aplic>;
            interrupts = <80 IRQ_TYPE_LEVEL_HIGH>;
            interrupt-controller;
            #interrupt-cells = <1>;
        };
    };
```

## Documentation/devicetree/bindings/mmc/cdns,sd6hc.yaml
```yaml
# SPDX-License-Identifier: GPL-2.0-only OR BSD-2-Clause
%YAML 1.2
---
$id: http://devicetree.org/schemas/mmc/cdns,sd6hc.yaml#
$schema: http://devicetree.org/meta-schemas/core.yaml#

title: Cadence SD6HC SD/SDIO/eMMC Host Controller

maintainers:
  - Tanmay Kathpalia <tanmay.kathpalia@altera.com>

description: |
  Cadence SD6HC is a sixth-generation SD/SDIO/eMMC host controller with an
  interface to a Cadence Combo PHY. The controller has separate card interface
  and bus interface clock domains.

  On Altera Agilex5 the SDHC, Combo PHY and SDMMC OCP bridge are each reset
  independently through the HPS Reset Manager.

  On Microchip PIC64-HPSC the controller sits in the NVM subsystem and has no
  reset controller. Its register interface only supports 32-bit accesses, and
  its interrupt is aggregated with the other NVM subsystem peripherals, so a
  second register region holding the shared NVM interrupt-clear register is
  required to acknowledge the eMMC/SD source. The PIC64-HPSC Combo PHY closes
  the DQS loopback internally, so no external loopback path is used.

properties:
  compatible:
    items:
      - enum:
          - altr,agilex5-sd6hc
          - microchip,pic64hpsc-sdhci
      - const: cdns,sd6hc

  reg:
    minItems: 1
    items:
      - description: SDHC register set (HRS and SRS)
      - description:
          Shared NVM subsystem interrupt-clear register, in which bit 3
          acknowledges the eMMC/SD interrupt source. PIC64-HPSC only,
          where it is mandatory.

  reg-names:
    minItems: 1
    items:
      - const: reg
      - const: int_clear

  interrupts:
    maxItems: 1

  clocks:
    items:
      - description: card interface unit (CIU / SDMCLK) clock
      - description: bus interface unit (BIU) clock

  clock-names:
    items:
      - const: ciu
      - const: biu

  resets:
    items:
      - description: SDHC controller reset
      - description: Combo PHY reset
      - description: SDMMC OCP/AXI reset

  reset-names:
    items:
      - const: sdhc-reset
      - const: combophy
      - const: sdmmc-ocp

  iommus:
    maxItems: 1

  dma-coherent: true

  cdns,iocell-input-delay-ps:
    description:
      Input delay across the IO cells, used for SD6HC PHY timing calculations.
    minimum: 0
    maximum: 20000
    default: 2500

  cdns,iocell-output-delay-ps:
    description:
      Output delay across the IO cells, used for SD6HC PHY timing calculations.
    minimum: 0
    maximum: 20000
    default: 2500

  cdns,delay-element-ps:
    description:
      DLL delay element size, used for SD6HC PHY timing calculations.
    minimum: 1
    maximum: 1000
    default: 24

required:
  - compatible
  - reg
  - interrupts
  - clocks
  - clock-names

allOf:
  - $ref: sdhci-common.yaml#
  # The PIC64-HPSC is the exception on both counts: its interrupt is shared
  # with the other NVM subsystem peripherals, so the aggregator's
  # interrupt-clear register is needed as a second region.
  - if:
      properties:
        compatible:
          contains:
            const: microchip,pic64hpsc-sdhci
    then:
      properties:
        reg:
          minItems: 2
        reg-names:
          minItems: 2
        resets: false
        reset-names: false
      required:
        - reg-names
    else:
      properties:
        reg:
          maxItems: 1
        reg-names: false
      required:
        - resets
        - reset-names

unevaluatedProperties: false

examples:
  - |
    #include <dt-bindings/interrupt-controller/arm-gic.h>

    mmc@10808000 {
        compatible = "altr,agilex5-sd6hc", "cdns,sd6hc";
        reg = <0x10808000 0x1000>;
        interrupts = <GIC_SPI 96 IRQ_TYPE_LEVEL_HIGH>;
        clocks = <&clkmgr 0>, <&clkmgr 1>;
        clock-names = "ciu", "biu";
        resets = <&rst 0>, <&rst 1>, <&rst 2>;
        reset-names = "sdhc-reset", "combophy", "sdmmc-ocp";
        iommus = <&smmu 5>;
        dma-coherent;
    };

  - |
    #include <dt-bindings/interrupt-controller/irq.h>

    soc {
        #address-cells = <2>;
        #size-cells = <2>;

        mmc@4001c038000 {
            compatible = "microchip,pic64hpsc-sdhci", "cdns,sd6hc";
            reg = <0x400 0x1c038000 0x0 0x2000>,
                  <0x400 0x1c020500 0x0 0x4>;
            reg-names = "reg", "int_clear";
            interrupt-parent = <&nvm_intc>;
            interrupts = <2 IRQ_TYPE_LEVEL_HIGH>;
            clocks = <&Lpclk>, <&Lhclk>;
            clock-names = "ciu", "biu";
            bus-width = <8>;
            non-removable;
            max-frequency = <200000000>;
            cap-mmc-highspeed;
            mmc-ddr-1_8v;
            mmc-hs200-1_8v;
            mmc-hs400-1_8v;
            mmc-hs400-enhanced-strobe;
            no-sd;
            no-sdio;
        };
    };
```

## Documentation/devicetree/bindings/riscv/sifive,extensiblecache0.yaml
```yaml
# SPDX-License-Identifier: (GPL-2.0 OR BSD-2-Clause)
# Copyright (C) 2023 SiFive, Inc.
%YAML 1.2
---
$id: http://devicetree.org/schemas/riscv/sifive,extensiblecache0.yaml#
$schema: http://devicetree.org/meta-schemas/core.yaml#

title: SiFive Extensible Cache Controller

maintainers:
  - Eric Lin      <eric.lin@sifive.com>

description:
  The SiFive Extensible Controller is a cache generator of high-performance extensible
  system cache.
  All the properties in ePAPR/DeviceTree specification applies for this platform.

allOf:
  - $ref: /schemas/cache-controller.yaml#

select:
  properties:
    compatible:
      contains:
        enum:
          - sifive,extensiblecache0

  required:
    - compatible

properties:
  compatible:
    items:
      - enum:
          - sifive,extensiblecache0
      - const: cache

  cache-block-size:
    const: 64

  cache-level:
    const: 3

  cache-sets:
    const: 1024

  cache-size:
    const: 1048576

  cache-unified: true

  interrupts:
    minItems: 1
    maxItems: 2

  reg:
    maxItems: 1

  '#address-cells':
    const: 1

  '#size-cells':
    const: 1

additionalProperties: false

required:
  - compatible
  - cache-block-size
  - cache-level
  - cache-sets
  - cache-size
  - cache-unified
  - interrupts
  - reg

examples:
  - |
    cache-controller0@2010000 {
      #address-cells = <1>;
      #size-cells = <1>;
      cache-block-size = <64>;
      cache-level = <3>;
      cache-sets = <1024>;
      cache-size = <1048576>;
      cache-unified;
      compatible = "sifive,extensiblecache0", "cache";
      reg = <0x2010000 0x4000>;
      interrupt-parent = <&L28>;
      interrupts = <2 4>;
    };
```
